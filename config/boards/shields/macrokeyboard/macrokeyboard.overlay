/ {
    chosen {
        zmk,keyboard = &macrokeyboard;
    };

    macrokeyboard {
        compatible = "zmk,direct-input";
        label = "MacroKeyboard";

        direct-gpios = <&gpio0 13 (GPIO_PULL_UP | GPIO_ACTIVE_LOW)>, // Linha 0, Botão 0
                       <&gpio0 14 (GPIO_PULL_UP | GPIO_ACTIVE_LOW)>, // Linha 0, Botão 1
                       <&gpio0 15 (GPIO_PULL_UP | GPIO_ACTIVE_LOW)>, // Linha 0, Botão 2

                       <&gpio0 16 (GPIO_PULL_UP | GPIO_ACTIVE_LOW)>, // Linha 1, Botão 0
                       <&gpio0 17 (GPIO_PULL_UP | GPIO_ACTIVE_LOW)>, // Linha 1, Botão 1
                       <&gpio0 18 (GPIO_PULL_UP | GPIO_ACTIVE_LOW)>, // Linha 1, Botão 2

                       <&gpio0 19 (GPIO_PULL_UP | GPIO_ACTIVE_LOW)>, // Linha 2, Botão 0
                       <&gpio0 20 (GPIO_PULL_UP | GPIO_ACTIVE_LOW)>, // Linha 2, Botão 1
                       <&gpio0 21 (GPIO_PULL_UP | GPIO_ACTIVE_LOW)>, // Linha 2, Botão 2

                       <&gpio0 9 (GPIO_PULL_UP | GPIO_ACTIVE_LOW)>, // Linha 3, Botão 0
                       <&gpio0 10 (GPIO_PULL_UP | GPIO_ACTIVE_LOW)>, // Linha 3, Botão 1
                       <&gpio0 31 (GPIO_PULL_UP | GPIO_ACTIVE_LOW)>; // Linha 3, Botão 2
    };
};
