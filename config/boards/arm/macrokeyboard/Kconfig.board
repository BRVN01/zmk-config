## config/boards/arm/macrokeyboard/Kconfig.board
```kconfig
#
# Copyright (c) 2023 The ZMK Contributors
# SPDX-License-Identifier: MIT
#

config BOARD_MACROKEYBOARD
    bool "macrokeyboard"
    depends on SOC_NRF52840_QIAA
```

## config/boards/arm/macrokeyboard/Kconfig.defconfig
```kconfig
#
# Copyright (c) 2023 The ZMK Contributors
# SPDX-License-Identifier: MIT
#

if BOARD_MACROKEYBOARD

config ZMK_KEYBOARD_NAME
    default "macrokeyboard"

#config ZMK_SPLIT_ROLE_CENTRAL
#    default y

endif # BOARD_MACROKEYBOARD

if BOARD_MACROKEYBOARD

config BOARD
    default "macrokeyboard"

#config ZMK_SPLIT
#    default y

config BT_CTLR
    default BT

if USB

config USB_NRFX
    default y

config USB_DEVICE_STACK
    default y

endif # USB

endif # BOARD_MACROKEYBOARD
```

## config/boards/shields/customboard/Kconfig.defconfig
```kconfig
if SHIELD_CUSTOMBOARD

config ZMK_KEYBOARD_NAME
    default "customboard"

endif
```

## config/boards/shields/macrokeyboard/Kconfig.defconfig
```kconfig
if SHIELD_MACROKEYBOARD

config ZMK_KEYBOARD_NAME
	default "macrokeyboard"
	
endif
```
