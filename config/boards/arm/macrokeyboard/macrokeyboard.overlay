
/ {
    chosen {
        zmk,kscan = &kscan0;
    };

    kscan0: kscan {
        compatible = "zmk,kscan-gpio-matrix"; // Usando matriz de teclado
        label = "KSCAN";

        // Defina os pinos das linhas
        row-gpios = <
            &gpio0 13 GPIO_ACTIVE_HIGH  // Linha 0
            &gpio0 14 GPIO_ACTIVE_HIGH  // Linha 1
            &gpio0 15 GPIO_ACTIVE_HIGH  // Linha 2
            &gpio0 16 GPIO_ACTIVE_HIGH  // Linha 3
        >;

        // Defina os pinos das colunas
        col-gpios = <
            &gpio0 17 GPIO_ACTIVE_HIGH  // Coluna 0
            &gpio0 18 GPIO_ACTIVE_HIGH  // Coluna 1
            &gpio0 19 GPIO_ACTIVE_HIGH  // Coluna 2
        >;

        // Configurações de debounce
        debounce-press-ms = <5>;
        debounce-release-ms = <5>;
        debounce-scan-period-ms = <1>;
        poll-period-ms = <10>;
    };
};